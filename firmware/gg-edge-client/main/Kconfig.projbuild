## firmware/gg-edge-client/sdkconfig.defaults
```kconfig
CONFIG_IDF_TARGET="esp32s3"
CONFIG_ESP_WIFI_SSID="YOUR_WIFI_SSID"
CONFIG_ESP_WIFI_PASSWORD="YOUR_WIFI_PASSWORD"
CONFIG_GG_IOT_ENDPOINT="REPLACE.iot.ap-southeast-2.amazonaws.com"
CONFIG_GG_THING_NAME="gg-edge-wt-dev-esp32-1"
CONFIG_GG_REGION="ap-southeast-2"
CONFIG_GG_BUTTON_GPIO=0
CONFIG_GG_RGB_GPIO=48
CONFIG_GG_TELEMETRY_INTERVAL_S=10
CONFIG_MBEDTLS_CERTIFICATE_BUNDLE=y
```
